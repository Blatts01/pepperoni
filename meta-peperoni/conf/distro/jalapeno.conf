## meta-peperoni/conf/distro/jalapeno.conf
```bitbake
# jalapeno.conf
DISTRO = "jalapeno"
DISTRO_NAME = "Jalapeno Linux"
DISTRO_VERSION = "1.0"

# You can customize the following lines according to your requirements
TARGET_ARCH = "qemuriscv64"
PACKAGE_CLASSES = "package_rpm"
EXTRA_IMAGE_FEATURES = "debug-tweaks"
PATCHRESOLVE = "noop"

require conf/distro/include/no-static-libs.inc
require conf/distro/include/yocto-uninative.inc
require conf/distro/include/security_flags.inc

INHERIT += "uninative"
```
